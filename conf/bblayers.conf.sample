## conf/bblayers.conf.sample
```bitbake
# LAYER_CONF_VERSION is increased each time build/conf/bblayers.conf
# changes incompatibly
POKY_BBLAYERS_CONF_VERSION = "2"

BBPATH = "${TOPDIR}"
BBFILES ?= ""

BBLAYERS ?= " \
  /home/build/shared/poky/meta \
  /home/build/shared/poky/meta-poky \
  /home/build/shared/poky/meta-yocto-bsp \
  /home/build/shared/meta-clang \
  /home/build/shared/meta-bsp_lemaker \
  /home/build/shared/meta-xmz-mod-touch \
  /home/build/shared/meta-openembedded/meta-oe \
  /home/build/shared/meta-rust \
  "
BBLAYERS_NON_REMOVABLE ?= " \
  /home/build/shared/poky/meta \
  /home/build/shared/poky/meta-poky \
  "
```

## conf/distro/eisenhardt.conf
```bitbake
require conf/distro/poky.conf

DISTRO = "eisenhardt"
DISTRO_NAME = "Eisenhardt & Felsenfest"
DISTRO_VERSION = "1.0"
DISTRO_CODENAME = "cat"
# DISTRO_FEATURES_append = " alsa"
SDK_VENDOR = "-catsdk"
SDK_VERSION := "${@'${DISTRO_VERSION}'.replace('snapshot-${DATE}', 'snapshot')}"
MAINTAINER = "zzeroo"
INHERIT += "buildhistory"
BUILDHISTORY_COMMIT = "1"

DISTRO_FEATURES_append = " fbdev wayland systemd"
```

## conf/layer.conf
```bitbake
# We have a conf and classes directory, add to BBPATH
BBPATH .= ":${LAYERDIR}"

# We have recipes-* directories, add to BBFILES
BBFILES += "${LAYERDIR}/recipes-*/*/*.bb \
            ${LAYERDIR}/recipes-*/*/*.bbappend"

BBFILE_COLLECTIONS += "meta-bsp_lemaker"
BBFILE_PATTERN_meta-bsp_lemaker = "^${LAYERDIR}/"
BBFILE_PRIORITY_meta-bsp_lemaker = "20"

LAYERDEPENDS_meta-bsp_lemaker = "core meta-sunxi"
LAYERSERIES_COMPAT_meta-bsp_lemaker = "dunfell"
```

## conf/machine/bananapro.conf
```bitbake
#@TYPE: Machine
#@NAME: Bananapro
#@DESCRIPTION: Machine configuration for the bananapro, based on allwinner A20 CPU https://linux-sunxi.org/LeMaker_Banana_Pro


PREFERRED_VERSION_linux-mainline = "5.5.%"

require conf/machine/include/sun7i.inc

KERNEL_DEVICETREE = "sun7i-a20-bananapro.dtb"
UBOOT_MACHINE = "Bananapro_config"

SERIAL_CONSOLES ?= "115200;ttyS0"

MACHINE_EXTRA_RDEPENDS += "linux-firmware-bcm43362"
```

## conf/machine/include/bpro-base.inc
```bitbake
include conf/machine/include/bpro-default-settings.inc
include conf/machine/include/bpro-default-versions.inc
include conf/machine/include/bpro-default-providers.inc

IMAGE_FSTYPES ?= "tar.bz2 sdcard"

KERNEL_IMAGETYPE ?= "zImage"

MACHINE_FEATURES += "vfat wifi"

MACHINE_EXTRA_RRECOMMENDS += " kernel-modules"

IMAGE_BOOT_FILES ?= " \
                 ${@bb.utils.contains('KERNEL_IMAGETYPE', 'zImage', '${KERNEL_IMAGETYPE}', '${KERNEL_IMAGETYPE};${SDIMG_KERNELIMAGE}', d)} \
                 ${@bb.utils.contains('KERNEL_IMAGETYPE', 'zImage', 'u-boot.bin;${SDIMG_KERNELIMAGE}', '', d)} \
                 ${@bb.utils.contains('KERNEL_IMAGETYPE', 'zImage', 'boot.scr;boot.scr', '', d)} \
                 "


# https://community.nxp.com/docs/DOC-105521
IMAGE_ROOTFS_EXTRA_SPACE = "100000"
IMAGE_OVERHEAD_FACTOR = "1.5"

# The kernel image is installed into the FAT32 boot partition and does not need
# to also be installed into the rootfs.
RDEPENDS_kernel-base = ""

SERIAL_CONSOLE ?= "115200 ttyS0"

SPL_BINARY="u-boot-sunxi-with-spl.bin"
UBOOT_MACHINE = "Bananapro_defconfig"
KERNEL_DEVICETREE = "sun7i-a20-bananapro.dtb"
```

## wic/sdimage-bananapro.wks
```
# short-description: Create Banana Pro SD card image
# long-description: Creates a partitioned SD card image for use with
# Banana Pro. Boot files are located in the first vfat partition.

part /boot --source bootimg-partition --ondisk mmcblk --fstype=vfat --label boot --active --align 4096 --size 20
part / --source rootfs --ondisk mmcblk --fstype=ext4 --label root --align 4096
```
